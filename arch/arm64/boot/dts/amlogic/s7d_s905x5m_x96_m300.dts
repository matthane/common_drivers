#include "s7d_s905x5m_4g_1gbit.dts"

/{
	model = "X96 M300";
	coreelec-dt-id = "s7d_s905x5m_x96_m300";

	gpioleds {
		sys_led {
			gpios = <&gpio GPIODV_5 GPIO_ACTIVE_LOW>;
		};
	};
};

&i2c3 {
	status = "disabled";
};
